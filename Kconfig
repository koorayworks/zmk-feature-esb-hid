## Kconfig
```kconfig
# HID over ESB module configuration.
# The vendored Nordic ESB stack (esb/) brings its own Kconfig (CONFIG_ESB*).

rsource "esb/Kconfig"

config ZMK_ESB_HID
	bool "HID over ESB transport (keyboard side)"
	depends on SOC_SERIES_NRF52X || SOC_SERIES_NRF53X || SOC_SERIES_NRF54LX
	select ESB
	select ESB_CLOCK_INIT
	select HWINFO
	select SETTINGS
	# NVS needs FLASH + FLASH_PAGE_LAYOUT; select it only where the
	# board provides them (e.g. the xiao_ble//zmk variant), so plain
	# board targets without flash still build (settings then have no
	# backend and saves simply fail at runtime there).
	select NVS if FLASH && FLASH_PAGE_LAYOUT
	help
	  Send this keyboard's HID reports (keyboard / consumer / mouse) over
	  Nordic ESB to a receiver running the same module with
	  ZMK_ESB_HID_RECEIVER enabled. Requires the ZMK fork hooks
	  (ZMK_TRANSPORT_ESB in endpoints).

	  SETTINGS/NVS hold the paired slot override ("esb_hid/slot"),
	  written when the receiver assigns a slot during pairing, and
	  the receiver profile list ("esb_hid/receivers") used by
	  multi-receiver support (ZMK_ESB_HID_MULTI_RECEIVER).

config ZMK_ESB_HID_SLOT
	int "ESB slot (pipe) this keyboard uses by default"
	depends on ZMK_ESB_HID
	range 0 3
	default 0
	help
	  Slot 0..3 = ESB pipe the keyboard transmits on. A slot assigned
	  during pairing is stored in settings ("esb_hid/slot") and takes
	  precedence over this build-time default.

config ZMK_ESB_HID_MULTI_RECEIVER
	bool "Remember multiple receivers and auto-select between them (keyboard side)"
	depends on ZMK_ESB_HID
	default y
	help
	  Store one profile per paired receiver ("esb_hid/receivers":
	  the receiver's hardware device ID plus the slot it assigned)
	  instead of a single slot, and hunt for the receiver that is
	  actually in range: at boot and whenever the link is lost, the
	  keyboard probes its known receivers in rotation and settles on
	  the first one that ACKs. This is what lets the same keyboard
	  work with the home receiver at home and the office receiver at
	  the office without re-pairing. Receivers append their device
	  ID to PAIR_ASSIGN; assignments from older receivers are kept
	  as a single unknown-identity profile. With only one known
	  receiver the behaviour is identical to the single-slot mode.

config ZMK_ESB_HID_DEVICE_NAME
	string "Device name advertised over ESB"
	depends on ZMK_ESB_HID
	default "KEYBOARD"
	help
	  Human-readable name sent in status v2 frames and in pairing
	  requests. Truncated to 16 characters on the wire. The receiver
	  shows it in its device list, and a pairing assignment is only
	  adopted when the name it carries matches this name exactly.

config ZMK_ESB_HID_STUDIO
	bool "ZMK Studio RPC over ESB (keyboard side)"
	depends on ZMK_ESB_HID
	depends on ZMK_STUDIO
	help
	  Register a Studio RPC transport bound to the ESB endpoint, so
	  ZMK Studio can edit this keyboard's keymap through the ESB
	  receiver's USB CDC forwarder. Studio stream fragments travel as
	  ESB_HID_TYPE_STUDIO frames; downlink fragments are pulled via
	  ESB ACK payloads, provoked by periodic poll frames from the
	  keyboard (fast while a session is active, slow when idle).

config ZMK_ESB_HID_STUDIO_RX
	bool "ZMK Studio over ESB forwarder (receiver side)"
	depends on ZMK_ESB_HID_RECEIVER
	help
	  Forward Studio RPC bytes between a second USB CDC ACM port
	  (devicetree node "esb_studio_cdc") and the ESB link: downlink
	  bytes are queued as ESB ACK payloads, uplink
	  ESB_HID_TYPE_STUDIO frames are written out to the CDC port.
	  Requires the shield to provide the esb_studio_cdc node.

config ZMK_ESB_HID_NOTIFY_RX
	bool "Deck notification channel (receiver side)"
	depends on ZMK_ESB_HID_RECEIVER
	help
	  Receive framed notifications from a PC-side notifier program
	  over a dedicated USB CDC ACM port (devicetree node
	  "deck_notify_cdc"), separate from the Studio forwarder port
	  (deck-notifications-design.md). This is step M1, the channel
	  skeleton: the forwarder answers HELLO with HELLO_ACK and
	  drops everything else; NOTIFY/RESOLVE handling and the
	  display UI arrive in later steps. Requires the shield to
	  provide the deck_notify_cdc node; enable it in the
	  production Deck (disptest) shield only.

config ZMK_ESB_HID_RECEIVER
	bool "HID over ESB receiver (ESB to USB HID)"
	depends on SOC_SERIES_NRF52X || SOC_SERIES_NRF53X || SOC_SERIES_NRF54LX
	select ESB
	select ESB_CLOCK_INIT
	select SETTINGS
	# NVS needs FLASH + FLASH_PAGE_LAYOUT; select it only where the
	# board provides them (e.g. the xiao_ble//zmk variant), so plain
	# board targets without flash still build (settings then have no
	# backend and saves simply fail at runtime there).
	select NVS if FLASH && FLASH_PAGE_LAYOUT
	help
	  Receive HID reports over Nordic ESB and forward them to USB HID.
	  Intended for a matrix-less ZMK build acting as the receiver.

	  SETTINGS/NVS hold the slot registry ("esb_hid/registry"): which
	  slots are paired, their device names, and the active slot.

config ZMK_ESB_HID_RX_BOOT_PAIRING
	bool "Open the pairing window automatically at boot (headless receiver)"
	depends on ZMK_ESB_HID_RECEIVER
	help
	  For receivers without a display UI there is no other way to
	  open the pairing window, so open it automatically once the
	  ESB link is up: the first free slot is targeted and the first
	  candidate that asks is assigned without a manual confirm.
	  The window is the usual 60 s pairing window; once a keyboard
	  is registered the receiver behaves exactly like a UI-driven
	  one. Only enable this on headless receivers — a receiver
	  with a UI (the Deck) should keep pairing under explicit
	  user control.

config ZMK_ESB_HID_RX_BOOT_PAIRING_AUTO
	bool "Auto-assign the first candidate in the boot pairing window"
	depends on ZMK_ESB_HID_RX_BOOT_PAIRING
	help
	  Assign the first candidate that asks in the boot pairing
	  window, with no confirmation step. This is the right mode
	  for headless receivers, which have no way to ask the user.
	  Display-equipped receivers should leave this off: the
	  window still opens at boot, but assignment then waits for
	  esb_hid_pairing_confirm() from the UI, so an accidental
	  pairing request cannot claim a slot silently.
```

## dts/bindings/behaviors/zmk,behavior-esb-pair.yaml
```yaml
# Copyright (c) 2026 The ZMK Contributors
# SPDX-License-Identifier: MIT

description: ESB Pairing Behavior

compatible: "zmk,behavior-esb-pair"

include: zero_param.yaml
```
